## external/ESP32S3/sdkconfig.defaults
```kconfig
# Chip target
CONFIG_IDF_TARGET="esp32s3"

# 16 MB flash
CONFIG_ESPTOOLPY_FLASHSIZE_16MB=y
CONFIG_ESPTOOLPY_FLASHSIZE="16MB"
CONFIG_PARTITION_TABLE_SINGLE_APP_LARGE=y

# Octal PSRAM (ESP-BOX-3 has 16 MB octal)
CONFIG_SPIRAM=y
CONFIG_SPIRAM_MODE_OCT=y
CONFIG_SPIRAM_SPEED_80M=y
CONFIG_SPIRAM_USE_MALLOC=y

# 240 MHz CPU clock
CONFIG_ESP_DEFAULT_CPU_FREQ_MHZ_240=y

# Memory for LVGL double buffering
CONFIG_LV_MEM_CUSTOM=y
CONFIG_LV_MEMCPY_MEMSET_STD=y

# Enable %f in LVGL's built-in sprintf so lv_label_set_text_fmt("%f", x)
# prints the number instead of a literal 'f'.
CONFIG_LV_USE_FLOAT=y

# USB Serial JTAG console
CONFIG_ESP_CONSOLE_USB_SERIAL_JTAG=y
```
